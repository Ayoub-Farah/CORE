## zephyr/modules/owntech_ota/zephyr/Kconfig
```kconfig
menuconfig OWNTECH_OTA
	bool "OwnTech collective CAN OTA (experimental)"
	default n
	depends on OWNTECH_COMMUNICATION_ENABLE_CAN
	depends on OWNTECH_FLASH && OWNTECH_SHIELD_API
	depends on BOOTLOADER_MCUBOOT
	depends on IMG_MANAGER
	select THINGSET_CAN_REPORT_RX
	select IMG_ENABLE_IMAGE_CHECK
	select CRC
	select ZCBOR
	select NET_BUF
	select BASE64 if OWNTECH_OTA_LEAD
	help
	  One bus, one campaign, sequential storage. Legacy ThingSet DFU must be
	  disabled so it cannot bypass the shared slot owner. A provisioned boot
	  profile and application maintenance/health hooks are required to write.

if OWNTECH_OTA

config OWNTECH_OTA_LEAD
	bool "Compile dedicated coordinator and USB file source"
	default n
	help
	  Build-time image class: a Lead cannot adopt a receiver application.
	  The receiver build omits the coordinator and fleet tables.

config OWNTECH_OTA_DEFERRED_ARM_QUALIFIED
	bool "Installed bootloader qualified for compact images and deferred arm"
	default n
	help
	  Enable only after validating erase geometry, sparse trailer writes and
	  MCUboot test-swap/rollback on the installed bootloader. Without this
	  qualification the receiver refuses PREPARE before erasing its slot.

config OWNTECH_OTA_QUEUE_DEPTH
	int "Ordered command/data queue depth"
	range 2 32
	default 8 if OWNTECH_OTA_LEAD
	default 3

config OWNTECH_OTA_STACK_SIZE
	int "OTA worker stack size"
	range 2048 16384
	default 4096

config OWNTECH_OTA_USABLE_SLOT_SIZE
	int "Useful image capacity, excluding padding (zero disables staging)"
	range 0 227328
	default 0

config OWNTECH_OTA_HARDWARE_ID
	hex "Provisioned hardware compatibility ID"
	default 0

config OWNTECH_OTA_LAYOUT_ID
	hex "Provisioned flash layout ID"
	default 0

config OWNTECH_OTA_BOOTLOADER_ID
	hex "Provisioned bootloader compatibility ID"
	default 0

config OWNTECH_OTA_HEALTH_TIMEOUT_MS
	int "Trial boot health deadline (ms)"
	range 1000 120000
	default 15000

config OWNTECH_OTA_BLOCK_INTERVAL_MS
	int "Minimum delay between OTA blocks (prototype, measure on hardware)"
	range 1 1000
	default 20

endif

config OWNTECH_OTA_RECOVERY
	bool "Dedicated recovery application for an explicitly selected uncommitted campaign"
	default n
	depends on !OWNTECH_OTA && OWNTECH_FLASH && OWNTECH_SHIELD_API && BOOTLOADER_MCUBOOT
	help
	  Build-only maintenance utility; requires a generated campaign and board
	  allowlist. This is never enabled in OTA or USB_LEAD application builds.
```
